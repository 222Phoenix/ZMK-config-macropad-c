/*
 * Copyright (c) 2022 The ZMK Contributors
 *
 * SPDX-License-Identifier: MIT
 */

#include <behaviors.dtsi>
#include <dt-bindings/zmk/keys.h>
#include <dt-bindings/zmk/mouse_settings.h>

#include "includes/mouse.dtsi"

/ {
    keymap {
        compatible = "zmk,keymap";

        default_layer {
            bindings = <
                // Blackpill onboard user key button
                &kp A

                // Switches connected directly to gpio pins
                &kp B
                &kp C
            >;
        };
    };
};

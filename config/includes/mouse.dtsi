
#include <dt-bindings/zmk/mouse.h>

/ {
    gpio_ps2: gpio_ps2 {
        compatible = "gpio-ps2";
        label = "gpio_ps2";
        scl-gpios = <&blackpill 40 0>;
        sda-gpios = <&blackpill 41 0>;
    };
};

/ {
    ps2_mouse: ps2_mouse {
        compatible = "zmk,ps2-mouse";
        label = "ps2_mouse";
        ps2-device = <&gpio_ps2>;
        rst-gpios = <&blackpill 42 0>;
    };
};


